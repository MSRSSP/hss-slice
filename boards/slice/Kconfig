## boards/slice/Kconfig
```kconfig
menu "Icicle-Kit Design Configuration Options"

config SOC_FPGA_DESIGN_XML
	string "Enter path to Libero XML file"
	default "boards/$(BOARD)/soc_fpga_design/xml/slice.xml"
	help
		This option specifies the design XML file to use.

config QEMU
	bool 
	default y
endmenu
```

## services/boot/Kconfig
```kconfig
config SERVICE_BOOT_DDR_SLICE_0_MEM_START
        hex "Slice-0 Mem start"
        default  0xa0000000
        help
                This feature specifies the slice-0 mem start.

config SERVICE_BOOT_DDR_SLICE_0_MEM_ORDER
        hex "Slice-0 Mem size order"
        default  28
        help
                This feature specifies the slice-0 mem order.

config SERVICE_BOOT_DDR_SLICE_BUS_ADDR
        hex "shared mem between slice-0 and slice-k"
        default  0xa0000000
        help
                This feature specifies the slice-0 mem bus.

config SERVICE_BOOT_DDR_SLICE_BUS_SIZE
        hex ""
        default  0x1000
        help
                This feature specifies the slice-0 mem bus size.

config SERVICE_BOOT_DDR_SLICE_PRIVATE_START
        hex "private mem for slice config"
        default  0xa001000
        help
                This feature specifies the slice_cfg only accessible to slice-0.

config SERVICE_BOOT_DDR_SLICE_FW_START
        hex "private location for opensbi copy"
        default  0xa002000
        help
                This feature specifies the private location for opensbi and the end of allocatable private mem for slice-0.

config SERVICE_BOOT_DDR_TARGET_ADDR
	hex "Target Base address for BOOT to DDR copy"
	default 0xA2000000
	depends on SERVICE_BOOT
	help
                This feature specifies a scratch address for EMMC/QSPI decompression

config SERVICE_BOOT
	def_bool y
	select SERVICE_OPENSBI
        select SERVICE_DDR
	help
                This feature enables support for bootstrapping the U54 application harts. This
                is enabled by default.

menu "Boot Service"
	visible if SERVICE_BOOT

config SERVICE_BOOT_SPI_FLASH_OFFSET
        hex "Copy payload from SPI FLASH at offset"
        default  0x400
        depends on SERVICE_SPI
        help
                This feature specifies the offset in SPI Flash where a boot image is stored.

config SERVICE_BOOT_USE_PAYLOAD
        bool "Use Payload file"
        default  n
        depends on SERVICE_BOOT 
        help
                This feature enables booting a directly contained payload.

config SERVICE_BOOT_CUSTOM_FLOW
        bool "Use Custom Boot Flow"
        default  n
        depends on SERVICE_BOOT
        help
                This feature enables custom booting flow where all HARTs
                will jump to same entry point in M-mode.

config SERVICE_BOOT_MMC_USE_GPT
        bool "Use GPT with MMC"
        default SERVICE_BOOT && SERVICE_MMC && y
	depends on SERVICE_MMC
	help
		If CONFIG_SERVICE_MMC is enabled, then for MMC boots this option enables 
                parsing of a GUID Partition Table (GPT) in search of the boot image starting
                sector..

endmenu
```
